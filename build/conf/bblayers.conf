## build/conf/bblayers.conf
```bitbake
# LAYER_CONF_VERSION is increased each time build/conf/bblayers.conf
# changes incompatibly
LCONF_VERSION = "6"

BBPATH = "${TOPDIR}"
BBFILES ?= ""

BBLAYERS ?= " \
  /usr/local/src/yocto/poky/meta \
  /usr/local/src/yocto/meta-fsl-arm \
  /usr/local/src/yocto/meta-fsl-arm-extra \
  /usr/local/src/yocto/poky/meta-yocto \
  /usr/local/src/yocto/poky/meta-yocto-bsp \
  /usr/local/src/yocto/meta-web-kiosk \
  /usr/local/src/yocto/meta-luciddg-kiosk \
  "

BBLAYERS_NON_REMOVABLE ?= " \
  /usr/local/src/yocto/poky/meta \
  /usr/local/src/yocto/poky/meta-yocto \
  "
```

## build/conf/local.conf
```bitbake
#MACHINE ?= "beaglebone"
#MACHINE ?= "genericx86-64"
MACHINE ?= "cubox-i"
#
# This sets the default machine to be qemux86 if no other machine is selected:
MACHINE ??= "genericx86-64"

# Where to place the build output
#
TMPDIR = "/usr/local/share/yocto"

DISTRO ?= "poky"
PACKAGE_CLASSES ?= "package_ipk"

USER_CLASSES ?= "buildstats image-mklibs image-prelink"

PATCHRESOLVE = "noop"

BB_DISKMON_DIRS = "\
    STOPTASKS,${TMPDIR},1G,100K \
    STOPTASKS,${DL_DIR},1G,100K \
    STOPTASKS,${SSTATE_DIR},1G,100K \
    ABORT,${TMPDIR},100M,1K \
    ABORT,${DL_DIR},100M,1K \
    ABORT,${SSTATE_DIR},100M,1K" 

CONF_VERSION = "1"

NO_RECOMMENDATIONS = "1"
IMAGE_INSTALL_append = " kernel-modules linux-firmware-bcm4329 linux-firmware-bcm4330 xkbcomp xkeyboard-config glib-networking busybox-udhcpc xf86-video-fbdev"
PACKAGE_EXCLUDE = "ssh-keys-client ssh-keys-server packagegroup-core-ssh-openssh openssh"
EXTRA_IMAGE_FEATURES = "read-only-rootfs"

ACCEPT_FSL_EULA = "1" # Be sure you actually do, please.

# The following is a terrible hack, but overriding variables specified in
#  conf files is hard to do, and impossible from within the layer. As such
#  we override here. This value comes from 
#    meta-fsl-arm-extra/conf/machine/cubox-i.conf
BOOT_SCRIPTS_forcevariable="uEnv-cubox-i.txt:uEnv.txt wifi.conf:wifi.conf browser.conf:browser.conf"
```
